
static const char *TAG = "main";
// #include <SD.h>
// #include <FS.h>
// #include <SPI.h>
// #include <vector>
#include <Arduino.h>
#include <M5Unified.h>
#include <esp_log.h>
#include "freertos/FreeRTOS.h"
#include "freertos/task.h"
#include "freertos/timers.h"

#include <string.h>
#include <stdio.h>
#include "esp_system.h"
#include "esp_log.h"
#include "nvs_flash.h"

#define LV_CONF_INCLUDE_SIMPLE
#include <lvgl.h>
#include <esp_timer.h>

#include <Adafruit_INA219.h>
Adafruit_INA219 ina219;
float shuntvoltage = 0;
float busvoltage = 0;
float current_mA = 0;
float loadvoltage = 0;
float power_mW = 0;
bool ina_inicialized = false;
volatile bool updateLabels = false;
void meassure();

#include "ui/ui.h"

extern lv_obj_t *ui_Chart1;
constexpr int32_t HOR_RES = 320;
constexpr int32_t VER_RES = 240;

#define SLEEP_TIME 60000
static int16_t stored_brightness = 127;
static bool is_dimmed = false;
static TimerHandle_t displayTimer = NULL;

lv_display_t *display;
lv_indev_t *indev;

void beep();
void beep2();
void click();
void updateBattery();
void setupDisplayTimer();

void my_display_flush(lv_display_t *disp, const lv_area_t *area, uint8_t *px_map)
{
  uint32_t w = (area->x2 - area->x1 + 1);
  uint32_t h = (area->y2 - area->y1 + 1);

  lv_draw_sw_rgb565_swap(px_map, w * h);
  M5.Display.pushImageDMA<uint16_t>(area->x1, area->y1, w, h, (uint16_t *)px_map);
  lv_disp_flush_ready(disp);
}

uint32_t my_tick_function()
{
  return (esp_timer_get_time() / 1000LL);
}

void my_touchpad_read(lv_indev_t *drv, lv_indev_data_t *data)
{
  M5.update();
  auto count = M5.Touch.getCount();

  if (count == 0)
  {
    data->state = LV_INDEV_STATE_RELEASED;
  }
  else
  {
    auto touch = M5.Touch.getDetail(0);
    data->state = LV_INDEV_STATE_PRESSED;
    data->point.x = touch.x;
    data->point.y = touch.y;

    // Reset LVGL's inactivity counter on touch
    lv_disp_trig_activity(NULL);
  }
}

const uint8_t wavdata[64] = {132, 138, 143, 154, 151, 139, 138, 140, 144, 147, 147, 147, 151,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 121, 129};

// continue setup code
void setup()
{
  esp_log_level_set("*", ESP_LOG_INFO);

  Serial.begin(115200);
  // Wire.begin();
  // Wire.setClock(400000);

  M5.begin();
  M5.Power.begin();
  M5.Display.setBrightness(stored_brightness);
  delay(100);

  M5.Speaker.begin();
  M5.Speaker.setVolume(42);
  /// Using a single wave of data, you can change the tone.
  M5.Speaker.tone(261.626, 1000, 1, false, wavdata, sizeof(wavdata));
  delay(200);
  M5.Speaker.tone(329.628, 1000, 2, false, wavdata, sizeof(wavdata));
  delay(200);
  M5.Speaker.tone(391.995, 800, 3, false, wavdata, sizeof(wavdata));
  delay(2000);

  lv_init();
  lv_tick_set_cb(my_tick_function);

  display = lv_display_create(HOR_RES, VER_RES);
  lv_display_set_flush_cb(display, my_display_flush);

  static lv_color_t buf1[HOR_RES * 15];
  lv_display_set_buffers(display, buf1, nullptr, sizeof(buf1), LV_DISPLAY_RENDER_MODE_PARTIAL);

  indev = lv_indev_create();
  lv_indev_set_type(indev, LV_INDEV_TYPE_POINTER);

  lv_indev_set_read_cb(indev, my_touchpad_read);

  Wire.end();
  if (!ina219.begin())
  {
    ESP_LOGE(TAG, "Failed to find INA219 chip");
  }
  else
  {
    ina_inicialized = true;
    ESP_LOGI(TAG, "INA219 chip found");
  }

  if (ina_inicialized)
  {
    ina219.setCalibration_32V_2A();
  }

  ui_init(); // Initialize UI generated by Square Line
  setupDisplayTimer();
}

void loop()
{
  M5.update();

  lv_task_handler();

  static uint32_t last_activity = lv_disp_get_inactive_time(NULL);

  if (lv_disp_get_inactive_time(NULL) > SLEEP_TIME)
  {
    if (!is_dimmed)
    {
      stored_brightness = M5.Display.getBrightness();
      M5.Display.setBrightness(0);
      is_dimmed = true;
    }
  }
  else
  {
    if (is_dimmed)
    {
      M5.Display.setBrightness(stored_brightness);
      is_dimmed = false;
    }
  }

  if (updateLabels)
  {
    updateLabels = false;
    char voltage_str[10];
    char power_str[10];
    char capacity_str[10];
    sprintf(voltage_str, "%.1f", loadvoltage);
    sprintf(power_str, "%.1f", power_mW / 1000.0); // Convert mW to W
    sprintf(capacity_str, "%.0f", current_mA);     // Convert mW to W

    lv_label_set_text(ui_Label_Voltage, voltage_str);
    lv_label_set_text(ui_Label_Power, power_str);
    lv_label_set_text(ui_Label_Capacity, capacity_str);
  }

  if (is_dimmed)
  {
    vTaskDelay(pdMS_TO_TICKS(50)); // Pomalejší aktualizace při spánku
  }
  else
  {
    vTaskDelay(pdMS_TO_TICKS(5)); // Normální rychlost
  }
}

void click()
{
  M5.Speaker.tone(5000, 50, 1, true, wavdata, sizeof(wavdata));
  // M5.Speaker.tone(400, 500, 1, true, wavdata, sizeof(wavdata));
}
void beep()
{
  M5.Speaker.tone(500, 1000, 1, true, wavdata, sizeof(wavdata));
  // M5.Speaker.tone(400, 500, 1, true, wavdata, sizeof(wavdata));
}

void beep2()
{
  M5.Speaker.tone(1000, 300, 1, true, wavdata, sizeof(wavdata));
  M5.Speaker.tone(2000, 300, 1, true, wavdata, sizeof(wavdata));
}

void CapacityClicked(lv_event_t *e)
{
  if (is_dimmed)
  {
    return;
  }

  click();
}

void displayUpdateValuesTimmer(TimerHandle_t xTimer)
{
  meassure();
  if (is_dimmed)
  {
    return; // Don't update if the display is dimmed
  }
  updateBattery();
}

void setupDisplayTimer()
{
  displayTimer = xTimerCreate(
      "DisplayTimer",           // Timer name
      pdMS_TO_TICKS(1000),      // Timer period in ticks (1000ms)
      pdTRUE,                   // Auto reload
      (void *)0,                // Timer ID
      displayUpdateValuesTimmer // Callback function
  );

  if (displayTimer != NULL)
  {
    xTimerStart(displayTimer, 0);
  }
}

void updateBattery()
{
  int32_t batPercentage = M5.Power.getBatteryLevel();
  lv_bar_set_value(ui_Battery, batPercentage, LV_ANIM_ON);

  int32_t current = M5.Power.getBatteryCurrent();
  if (current > 0)
  {
    lv_obj_clear_flag(ui_ScreenMain_Charging, LV_OBJ_FLAG_HIDDEN);
  }
  else
  {
    lv_obj_add_flag(ui_ScreenMain_Charging, LV_OBJ_FLAG_HIDDEN);
  }

  // Pro debug můžeme vypsat hodnoty do sériové konzole
  ESP_LOGI(TAG, "Battery: %d%%, current: %d", batPercentage, current);
}

void meassure()
{
  if (!ina_inicialized)
    return;
  if (ina219.success())
  {
    shuntvoltage = ina219.getShuntVoltage_mV();
    busvoltage = ina219.getBusVoltage_V();
    current_mA = ina219.getCurrent_mA();
    power_mW = ina219.getPower_mW();
    loadvoltage = busvoltage + (shuntvoltage / 1000);

    Serial.print("Bus Voltage:   ");
    Serial.print(busvoltage);
    Serial.println(" V");
    Serial.print("Shunt Voltage: ");
    Serial.print(shuntvoltage);
    Serial.println(" mV");
    Serial.print("Load Voltage:  ");
    Serial.print(loadvoltage);
    Serial.println(" V");
    Serial.print("Current:       ");
    Serial.print(current_mA);
    Serial.println(" mA");
    Serial.print("Power:         ");
    Serial.print(power_mW);
    Serial.println(" mW");

    updateLabels = true;
  }
  else
  {
    Serial.println("INA219 not successful");
  }
}